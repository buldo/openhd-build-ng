## openhd-openipc/openhd/Config.in
```kconfig
config BR2_PACKAGE_OPENHD
    bool "openhd"
    select BR2_PACKAGE_LIBPCAP
    select BR2_PACKAGE_LIBSODIUM
    select BR2_PACKAGE_GSTREAMER1
    select BR2_PACKAGE_GST1_PLUGINS_BASE
	  select BR2_PACKAGE_GST1_PLUGINS_BASE_PLUGIN_APP
    select BR2_PACKAGE_GST1_PLUGINS_BAD
    select BR2_PACKAGE_GST1_PLUGINS_BAD_PLUGIN_SDP
    select BR2_PACKAGE_LIBV4L
    select BR2_PACKAGE_LIBUSB

    help
      OpenHD package
```
